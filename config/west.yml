## config/west.yml
```yaml
manifest:
  remotes:
    - name: zmkfirmware
      url-base: https://github.com/lim6112j/
    - name: m165437
      url-base: https://github.com/M165437
  projects:
    - name: zmk-ftc
      remote: zmkfirmware
      revision: mouse-ftc
      import: app/west.yml
    - name: nice-view-gem
      remote: m165437
      revision: main
  self:
    path: config
```
